## conf/distro/arago.conf
```bitbake
# Set the collections
require conf/collections.inc
COLLECTIONS = "${OEBASE}/arago/ ${OEBASE}/arago-oe-dev/"

# Optionally add BOM, Custom and Test collections, if exist
COLLECTIONS =. "${@['', bb.data.getVar('OEBASE', d, 1)+'/arago-test/ '][os.path.exists(bb.data.getVar('OEBASE', d, 1)+'/arago-test/')]}"
COLLECTIONS =. "${@['', bb.data.getVar('OEBASE', d, 1)+'/arago-custom/ '][os.path.exists(bb.data.getVar('OEBASE', d, 1)+'/arago-custom/')]}"
COLLECTIONS =. "${@['', bb.data.getVar('OEBASE', d, 1)+'/arago-bom/ '][os.path.exists(bb.data.getVar('OEBASE', d, 1)+'/arago-bom/')]}"

# Use the BBMASK below to instruct BitBake to _NOT_ consider some .bb files
# This is a regular expression, so be sure to get your parenthesis balanced.
BBMASK = "(nonworking|obsolete)"

# Toolchain should be selected by setting TOOLCHAIN_BRAND in local.conf
# Set some sane defaults, in case someone forgets to set them in local.conf
TOOLCHAIN_BRAND ?= "csl"
TOOLCHAIN_TYPE ?= "external"

require conf/distro/include/toolchain-${TOOLCHAIN_TYPE}-${TOOLCHAIN_BRAND}.inc

# Enable capturing license files from sources (temporarily disabled)
# INHERIT += "distribute_license"

# Enable generation of source packages for SDKs
require conf/arago-source-ipk.conf

INHERIT += "amend"
FILESPATHBASE = "${@':'.join(sorted(list(set((bb.data.getVar('FILE_DIRNAME', d, 1).replace(bb.data.getVar('OEBASE', d, 1)+'/arago-oe-dev/', bb.data.getVar('OEBASE', d, 1)+'/arago/')+':'+bb.data.getVar('FILE_DIRNAME', d, 1)).split(':'))),None,None,True))}"

ANGSTROM_QT_VERSION = "4.6.3"
ARAGO_QT_PROVIDER = "qt4-embedded"

# Enable Qt+GLES for ARM v7a devices
ARAGO_QT_PROVIDER_armv7a = "qt4-embedded-gles"

require conf/distro/angstrom-2008.1.conf

# Put resulting images and packages in deploy directory outside of temp
# Doesn't work at the moment due to the way pstage works
#DEPLOY_DIR = "${OEBASE}/arago-deploy"

require conf/distro/include/arago-prefs.inc

include conf/arago-bom.conf

# Disable DropBear for now due to export restrictions
DISTRO_SSH_DAEMON ?= ""

# Don't install kernel image into the filesystem
RDEPENDS_kernel-base = ""

# Specify the feed configuration
ANGSTROM_FEED_CONFIGS = "arago-feed-configs"

# Feed configuration
ARAGO_URI = "http://feeds.arago-project.org"
ARAGO_FEED_BASEPATH = "feeds/live/${ANGSTROM_PKG_FORMAT}"
DISTRO_FEED_URI = "${ARAGO_URI}/${ARAGO_FEED_BASEPATH}"

# Enabling these 2 lines will cut the initial build time by utilizing
# pre-built native staging packages. Warning: this feature is not safe
# for multi-user environment, as it sets a global temp/work directory
# TMPDIR = "/tmp/arago"
# DEPLOY_DIR_PSTAGE = "${TMPDIR}/pstage"

# Set the distro name and version, since we now produce own SDK
DISTRO_NAME = "Arago"
DISTRO_VERSION = "2011.09"
BUILDNAME = "${DISTRO_NAME} ${DISTRO_VERSION}"
MAINTAINER = "Arago Developers <arago-devel@gforge.ti.com>"

TARGET_CC_ARCH_pn-cairo_armv5te = ""

# Set image and sdk names
SDK_DISTRO = "arago"
SDK_SUFFIX = "sdk"
SDK_NAME = "${SDK_DISTRO}-${DISTRO_VERSION}/${BASE_PACKAGE_ARCH}"
IMAGE_NAME = "${IMAGE_BASENAME}-${LIBC}-${ANGSTROM_PKG_FORMAT}-${DISTRO_VERSION}-${MACHINE}"
TOOLCHAIN_OUTPUTNAME := "${SDK_DISTRO}-${DISTRO_VERSION}-${FEED_ARCH}-${TARGET_OS}-${SDK_SUFFIX}"

require conf/distro/include/arago.inc

# Filter out angstrom blacklister from the inherit list
INHERIT := "${@filter_out('angstrom', bb.data.getVar('INHERIT', d, 1), d)}"
INHERIT += "angstrom-mirrors"

# Add own mirrors
INHERIT += "arago-mirrors"
CVS_TARBALL_STASH += "http://arago-project.org/files/sources/"

require conf/distro/include/toolchain-common-${TOOLCHAIN_TYPE}.inc

SDK_PATH := "${@["/${SDK_NAME}", bb.data.getVar('META_SDK_PATH', d, 1)][bool(bb.data.getVar('META_SDK_PATH', d, 1))]}"
```

## conf/distro/include/arago-prefs.inc
```bitbake
# Set some preferences
PREFERRED_PROVIDER_initscripts = "initscripts"
PREFERRED_PROVIDER_ncurses-tools = "ncurses"
PREFERRED_PROVIDER_libopkg-dev = "opkg"
PREFERRED_PROVIDER_ti-lpm-module = "ti-local-power-manager"
PREFERRED_PROVIDER_ti-dsplink-module = "ti-dsplink"
PREFERRED_PROVIDER_qt4-embedded = "${ARAGO_QT_PROVIDER}"

# Use the git version of tslib which works with latest 2.6.37 kernels
PREFERRED_VERSION_tslib = "1.0+gitr%"

# Version 0.7.3_0.8.0-rc of wpa-supplicant and hostap-daemon is required 
# for AM-SDK and the mac80211 wireless stack
PREFERRED_VERSION_wpa-supplicant = "0.7.3+0.8.0-rc"
PREFERRED_VERSION_hostap-daemon = "0.7.3+0.8.0-rc"
PREFERRED_VERSION_wpa-gui-e = "0.7.3+0.8.0-rc"

# Lock udev at 141, as recent versions cannot be built with csl2009q1
PREFERRED_VERSION_udev = "141"

# Pin gstreamer version 0.10.30, as newer conflicts with xdc headers
# keyword 'restrict' being defined in both headers, unpin when xdc fixed
PREFERRED_VERSION_gstreamer = "0.10.30"
PREFERRED_VERSION_gst-plugins-base = "0.10.30"
PREFERRED_VERSION_gst-plugins-good = "0.10.25"
PREFERRED_VERSION_gst-plugins-bad = "0.10.20"
PREFERRED_VERSION_gst-plugins-ugly = "0.10.16"

# Lock down older libxml2-native for RHEL4 compatibility
PREFERRED_VERSION_libxml2-native = "2.7.3"

# Override gcc-4.3 defaults, when building gcc-4.5 toolchain
ANGSTROM_GCC_VERSION			= "4.5"
ANGSTROM_BINUTILS_VERSION		= "2.20.1"
ANGSTROM_BINUTILS_VERSION_armv7a	= "2.20.1"
PREFERRED_VERSION_eglibc		= "2.12"
PREFERRED_VERSION_eglibc-initial	= "2.12"
```

## conf/distro/include/toolchain-common-external.inc
```bitbake
# Black magic to automatically set SDK_PATH out of PATH - don't touch this!
# Works with pretty much any external toolchain, like CS Lite or MV Pro 5
# Handles cross-toolchain vs. native toolchain
# SDK_PATH can be overwritten externally by META_SDK_PATH, e.g. for SDK
TOOLCHAIN_SYSPATH := "${@os.path.abspath(os.path.dirname(bb.which(bb.data.getVar('PATH', d, 1), bb.data.getVar('TARGET_PREFIX', d, 1)+'cpp'))+'/../'+bb.data.getVar('TARGET_SYS', d, 1))}"
TOOLCHAIN_PATH := "${@bool(bb.data.getVar('TOOLCHAIN_SYSPATH', d, 1)) and (os.path.exists(bb.data.getVar('TOOLCHAIN_SYSPATH', d, 1)) and os.path.dirname(bb.data.getVar('TOOLCHAIN_SYSPATH', d, 1)) or bb.fatal('No valid toolchain in PATH')) or ''}"
```

## conf/distro/include/toolchain-common-internal.inc
```bitbake
# Settings common to internal toolchains

# Override gcc-4.3 defaults, when building gcc-4.5 toolchain
ANGSTROM_GCC_VERSION			= "4.5"
ANGSTROM_BINUTILS_VERSION		= "2.20.1"
ANGSTROM_BINUTILS_VERSION_armv7a	= "2.20.1"
PREFERRED_VERSION_eglibc		= "2.12"
PREFERRED_VERSION_eglibc-initial	= "2.12"

# Other common settings
TARGET_VENDOR = "-arago"

TOOLCHAIN_INCLUDE_IN_SDK = "1"

PREFERRED_PROVIDER_binutils-cross-sdk = "binutils-cross-sdk"
PREFERRED_PROVIDER_gcc-cross-sdk = "gcc-cross-sdk"
PREFERRED_PROVIDER_gdb-cross-sdk = "gdb-cross-sdk"
PREFERRED_PROVIDER_gdbserver = "gdbserver"
```

## conf/distro/include/toolchain-external-angstrom.inc
```bitbake
# Set the necessary variables to use binary Angstrom toolchain
TOOLCHAIN_VENDOR = "-angstrom"
```

## conf/distro/include/toolchain-external-arago.inc
```bitbake
# Set the necessary variables to use binary Arago toolchain
TOOLCHAIN_VENDOR = "-arago"

TOOLCHAIN_INCLUDE_IN_SDK = "1"

PREFERRED_PROVIDER_binutils-cross-sdk = "external-toolchain-sdk-${TOOLCHAIN_BRAND}"
PREFERRED_PROVIDER_gcc-cross-sdk = "external-toolchain-sdk-${TOOLCHAIN_BRAND}"
PREFERRED_PROVIDER_gdb-cross-sdk = "external-toolchain-sdk-${TOOLCHAIN_BRAND}"
```

## conf/distro/include/toolchain-external-csl.inc
```bitbake
# Set the necessary variables to use binary CodeSourcery Lite
TOOLCHAIN_VENDOR = "-none"

# External CSL toolchain/glibc
TOOLCHAIN_TARGET_EXCLUDE += "\
    libc6 \
    libc6-dev \
    glibc-extra-nss \
    libgcc1 \
    linux-libc-headers-dev \
    libthread-db1 \
    sln \
    libstdc++ \
    libstdc++-dev \
    "

PREFERRED_VERSION_gdbserver = "6.6"
PREFERRED_VERSION_gdb = "6.6"
PREFERRED_VERSION_gdb-cross-sdk = "6.6"
PREFERRED_PROVIDER_gdbserver = "gdbserver"
```

## conf/distro/include/toolchain-external-mvl5.inc
```bitbake
# Set the necessary variables to use binary MontaVista Pro 5.0 (/opt/montavista/pro/devkit/arm/v5t_le)
# NOTE: this has not been used/verified in long time and may no longer work
TARGET_VENDOR = "v5tl-montavista"
TARGET_PREFIX = "arm_v5t_le-"
TARGET_CPPFLAGS_append = " -I${SDK_PATH}/target/usr/include "
TARGET_LDFLAGS_prepend = " -L${SDK_PATH}/target/lib -Wl,-rpath-link,${SDK_PATH}/target/lib "
TOOLCHAIN_TYPE = "external"
TOOLCHAIN_BRAND = "generic"
```

## conf/distro/include/toolchain-internal-arago.inc
```bitbake
# Set the necessary variables to build and use Arago toolchain from sources

# By default gcc-4.3 uses glibc, while gcc-4.5 uses eglibc
ANGSTROMLIBC = "eglibc"
```

## conf/machine/am181x-evm.conf
```bitbake
#@TYPE: Machine
#@NAME: AM181x CPUs on an AM181x EVM board
#@DESCRIPTION: Machine configuration for the TI AM181x EVM board

require conf/machine/include/davinci.inc
require conf/machine/include/omapl138.inc

UBOOT_MACHINE = "da850evm_config"
UBOOT_ENTRYPOINT = "0xc0008000"
UBOOT_LOADADDRESS = "0xc0008000"

MACHINE_FEATURES = "kernel26 serial ethernet"

SERIAL_CONSOLE = "115200 ttyS2"

PREFERRED_PROVIDER_virtual/kernel = "linux-davinci"
PREFERRED_PROVIDER_virtual/bootloader = "u-boot"
```

## conf/machine/am3359-evm.conf
```bitbake
#@TYPE: Machine
#@NAME: AM3359 EVM
#@DESCRIPTION: Machine configuration for the TI AM3359 EVM
TARGET_ARCH = "arm"

PREFERRED_PROVIDER_virtual/xserver = "xserver-xorg"
XSERVER = "xserver-xorg \
           xf86-input-evdev \
           xf86-input-mouse \
           xf86-input-tslib \
           xf86-video-omapfb \
           xf86-input-keyboard"

GUI_MACHINE_CLASS = "smallscreen"

require conf/machine/include/ti33x.inc

IMAGE_FSTYPES ?= "tar.bz2"

SERIAL_CONSOLE = "115200 ttyO0"

PREFERRED_PROVIDER_virtual/kernel = "linux-am335x"

PREFERRED_PROVIDER_virtual/bootloader = "u-boot"

UBOOT_ARCH = "arm"
UBOOT_MACHINE = "am335x_evm_config"

MACHINE_FEATURES = "kernel26 apm usbgadget usbhost vfat ext2 screen touchscreen"
```

## conf/machine/am45x-evm.conf
```bitbake
#@TYPE: Machine
#@NAME: OMAP4430 EVM
#@DESCRIPTION: Machine configuration for the OMAP4430 EVM

require conf/machine/include/omap4.inc

# NOTE: Currently this uses the pandaboard configuration until there is
#       an official PSP release for this device.  The kernel and bootloaders
#       come from mainline OE.
XLOAD_MACHINE = "omap4430panda_config"
XLOAD_LOAD_ADDRESS = 0x40304350

PREFERRED_PROVIDER_virtual/bootloader = "u-boot"
UBOOT_MACHINE = "omap4_panda_config"

PREFERRED_PROVIDER_virtual/kernel = "linux-omap4"

PREFERRED_PROVIDER_virtual/xserver = "xserver-xorg"
XSERVER = "xserver-xorg \
           xserver-xorg-extension-dri \
           xserver-xorg-extension-dri2 \
           xserver-xorg-extension-glx \
           xf86-input-evdev \
           xf86-input-mouse \
           xf86-input-tslib \
           xf86-video-fbdev \
           xf86-input-keyboard"

GUI_MACHINE_CLASS = "bigscreen"

IMAGE_FSTYPES += "tar.bz2"

SERIAL_CONSOLE = "115200 ttyO2"

MACHINE_EXTRA_RRECOMMENDS = " kernel-modules"
MACHINE_FEATURES = "kernel26 alsa apm ext2 screen touchscreen usbgadget usbhost vfat"
```

## conf/machine/arago-armv7.conf
```bitbake
#@TYPE: Machine
#@NAME: Arago unified machine
#@DESCRIPTION: Unified Arago machine configuration for TI/Arago ARMv7 platforms
TARGET_ARCH = "arm"

include conf/machine/include/tune-cortexa8.inc

IMAGE_FSTYPES = "tar.gz"

SERIAL_CONSOLE = ""

PREFERRED_PROVIDER_virtual/kernel ?= "linux-arago"

MACHINE_FEATURES = "kernel26 apm usbgadget usbhost vfat ext2 screen touchscreen"
```

## conf/machine/c6a811x-evm.conf
```bitbake
#@TYPE: Machine
#@NAME: c6a811x evm
#@DESCRIPTION: Machine configuration for the c6a811x evm

require conf/machine/include/ti811x.inc
```

## conf/machine/dm814x-custom.conf
```bitbake
#@TYPE: Machine
#@NAME: DM814x custom
#@DESCRIPTION: Machine configuration for the DM814x evm custom (currently VS/VC)

require conf/machine/include/ti814x.inc
```

## conf/machine/dm816x-custom.conf
```bitbake
#@TYPE: Machine
#@NAME: DM816x custom
#@DESCRIPTION: Machine configuration for the DM816x evm custom (currently VS/VC)

require conf/machine/include/ti816x.inc
```

## conf/machine/dm816x-evm.conf
```bitbake
#@TYPE: Machine
#@NAME: DM816x evm
#@DESCRIPTION: Machine configuration for the DM816x evm

require conf/machine/include/ti816x.inc
```

## conf/machine/include/tnetv107x.inc
```bitbake
TARGET_ARCH = "arm"
SOC_FAMILY = "tnetv107x"

require conf/machine/include/tune-arm1176-novfp.inc

PREFERRED_PROVIDER_virtual/kernel = "linux-tnetv107x"
MACHINE_KERNEL_PR = "r1"
KERNEL_IMAGETYPE = "uImage"

PREFERRED_PROVIDER_virtual/bootloader = "u-boot"
PREFERRED_VERSION_u-boot = "tnetv107x"
UBOOT_ARCH = "arm"
UBOOT_ENTRYPOINT = "0x80008000"
UBOOT_LOADADDRESS = "0x80008000"
EXTRA_IMAGEDEPENDS += "u-boot"
```

## conf/machine/include/tune-arm1176-novfp.inc
```bitbake
TARGET_CC_ARCH = "-march=armv6j -mtune=arm1176jz-s"
FEED_ARCH = "armv6-novfp"
BASE_PACKAGE_ARCH = "armv6-novfp"
PACKAGE_EXTRA_ARCHS += "armv4 armv4t armv5te armv6-novfp"
```

## conf/machine/tnetv107x-evm.conf
```bitbake
#@TYPE: Machine
#@NAME: TNETV107X EVM
#@DESCRIPTION: Machine configuration for the TI TNETV107X EVM

GUI_MACHINE_CLASS = "smallscreen"

require conf/machine/include/tnetv107x.inc

IMAGE_FSTYPES ?= "jffs2 tar.bz2"
EXTRA_IMAGECMD_jffs2 = "-lnp -e 0x20000 -s 2048"

SERIAL_CONSOLE = "115200 ttyS0"
USE_VT = "0"

UBOOT_MACHINE = "tnetv107x_evm_config"

MACHINE_FEATURES = "kernel26 apm usbgadget usbhost vfat ext2 screen touchscreen ethernet"
```
